## lichee/rtos-hal/hal/source/vin/modules/sensor/Kconfig
```kconfig
config SENSOR_GC1054_MIPI
	bool "use gc1054_mipi driver"
	default n

config SENSOR_GC1084_MIPI
	bool "use gc1084_mipi driver"
	default n

config SENSOR_GC1084_8BIT_MIPI
	bool "use gc1084_mipi 8bit"
	depends on SENSOR_GC1084_MIPI
	default n

config SENSOR_GC2053_MIPI
	bool "use gc2053_mipi driver"
	default n

config SENSOR_GC2053_8BIT_MIPI
	bool "use gc2053_mipi 8bit"
	depends on SENSOR_GC2053_MIPI
	default n

config SENSOR_GC2083_MIPI
	bool "use gc2083_mipi driver"
	default n

config SENSOR_GC4663_MIPI
	bool "use gc4663_mipi driver"
	default n

config SENSOR_SC2355_MIPI
	bool "use sc2355_mipi driver"
	default n

config SENSOR_SC202CS_VC_MIPI
	bool "use sc202cs_vc_mipi driver"
	default n

config SENSOR_SC2336_MIPI
	bool "use sc2336_mipi driver"
	default n

config SENSOR_SC3336_MIPI
	bool "use sc3336_mipi driver"
	default n

config SENSOR_SC500AI_MIPI
	bool "use sc500ai_mipi driver"
	default n

config SENSOR_SC5336_MIPI
	bool "use sc5336_mipi driver"
	default n

config SENSOR_SC5336P_MIPI
	bool "use sc5336p_mipi driver"
	default n

config SENSOR_TP9950_MIPI
        bool "use tp9950_mipi driver"
        default n

config SENSOR_TP9953_DVP
        bool "use tp9953_dvp driver"
        default n

config SENSOR_IMX319_MIPI
	bool "use imx319_mipi driver"
	default n

config SENSOR_IMX335_MIPI
	bool "use imx335_mipi driver"
	default n

config SENSOR_SC035HGS_MIPI
	bool "use sc035hgs_mipi driver"
	default n

config SENSOR_TP2815_MIPI
	bool "use tp2815_mipi driver"
	default n

config SENSOR_GC0406_MIPI
	bool "use gc0406_mipi driver"
	default n

config SENSOR_BF2253L_MIPI
	bool "use bf2253l_mipi driver"
	default n

config SENSOR_N5_DVP
	tristate "use n5_dvp driver"
	default n

config SENSOR_BF2257CS_MIPI
	tristate "use bf2257cs_mipi driver"
	default n

config SENSOR_F355P_MIPI
	tristate "use f355p_mipi driver"
	default n

config SENSOR_F355P_DVP
	tristate "use f355p_dvp driver"
	default n

config SENSOR_F37P_DVP
	tristate "use f37p_dvp driver"
	default n

config SENSOR_F37P_MIPI
	tristate "use f37p_mipi driver"
	default n

config SENSOR_OV02B10_MIPI
	tristate "use ov02b10_mipi driver"
	default n

config SENSOR_SC200AI_MIPI
	bool "use sc200ai_mipi driver"
	default n

config SENSOR_SC200AI_8BIT_MIPI
	bool "use SC200AI_mipi 8bit"
	depends on SENSOR_SC200AI_MIPI
	default n

config SENSOR_CV5003_MIPI
	bool "use cv5003_mipi driver"
	default n
```

## lichee/rtos-hal/hal/test/aiisp/Kconfig
```kconfig
menu "AIISP Devices"

config DRIVERS_AIISP
    bool "enable aiisp driver"
        default n

config HAL_TEST_AIISP
    bool "enable aiisp demo test command"
    depends on DRIVERS_AIISP
        default n
endmenu
```
