## lichee/linux-4.9/drivers/input/touchscreen/ilitek_limv5_3_0/Kconfig
```kconfig
#
#  Touchscreen driver configuration
#
config  TOUCHSCREEN_ILITEK2511
	tristate  "ilitek2511  touchscreen driver"
	depends on INPUT && I2C
	default m
	help
	  ilitek2511 touchscreen new driver, optimize anti-shake
```

## lichee/linux-4.9/drivers/media/platform/sunxi-vin/Kconfig
```kconfig
config CSI_VIN
	tristate "v4l2 new driver for SUNXI"
	default m
	select VIDEOBUF2_DMA_CONTIG

config ENABLE_SENSOR_FLIP_OPTION
	bool "select sensor flip to replace vipp flip"
	default n
	help
	   you cant flip in vipp when you select LBC format,
	   so you can enable it to active sensor flip operation.

config ENABLE_MIPI_TRNDS_RECOVER
	bool "enable mipi check and recovery when mipi d0/1 clk was be trnds"
	default n
	help
	   sometime mipi d0/1 clk will trnds when receive trands signal(maybe
	   false signal) and it case cant receive stream data. this will check
	   and recovery this case.

config CSI_CCI
	tristate "use cci function"
	default m
	help
		CCI is a hardware module in CSI. you can make it to
		be cci or i2c in the system.

if CSI_CCI
source "drivers/media/platform/sunxi-vin/vin-cci/Kconfig"
endif

config FLASH
	tristate "use flash module"
	default n

config ACTUATOR
	tristate "use actuator module"
	default n

config SENSOR_LIST
	tristate "sensor list for adaptive"
	default n

config BUF_AUTO_UPDATE
	bool "buf addr update for hardware"
	default n

config VIN_LOG
	bool "use vin log for debug"
	default n

config PIPELINE_RESET
	bool "use pipeline reset when timeout"
	default n

config MULTI_FRAME
	bool "multi-frame interrupt mode"
	default n

config SUPPORT_ISP_TDM
	bool "use isp for time sharing multiplex"
	default n

config TDM_LBC_EN
	bool "tdm reduces buf size by compression"
	depends on SUPPORT_ISP_TDM
	default y

config TDM_ONE_BUFFER
	bool "tdm use one buffer mode"
	depends on SUPPORT_ISP_TDM
	default n
	help
		need ensure sensor vbland > 20%

config TDM_ONE_BUFFER_WITH_TWORX
	bool "tdm use one buffer mode with two tdm_rx run"
	depends on TDM_ONE_BUFFER
	default n

config TDM_OFFLINE_HANDLE_RAW
	bool "tdm receive raw data to user and than get it from user, finally return to isp"
	depends on SUPPORT_ISP_TDM
	default n

config MIPI_VC
	bool "use mipi vc mode"
	default n

config MIPI_VC_VPOS
	bool "use vpos mode"
	depends on MIPI_VC
	default n

config AVG_TDM_FIFO
	bool "set the tdm four channels fifo the same"
		default n
config DISPPLAY_SYNC
	bool "use one buffer for delay display"
	default n

config VIN_IOMMU
	bool "use IOMMU for memery alloc"
	default n

config D3D
	bool "ISP 3D denoise module"
	default n

config D3D_LTF_EN
	bool "ISP 3D denoise long time frame"
	depends on D3D
	default n

config D3D_COMPRESS_EN
	bool "ISP 3D denoise reduces buf size by compression"
	depends on D3D
	default	n

config WDR
	bool "ISP WDR module"
	default y

config WDR_COMPRESS_EN
	bool "ISP WDR reduces buf size by compression"
	depends on WDR
	default	n

config FRAMEDONE_TWO_BUFFER
	bool "use two buffer in bk frame done interrupt"
	default	n

config ISP_SERVER_MELIS
	bool "use ISP server from melis"
	default n

config VIN_INIT_MELIS
	bool "vin and isp init in melis"
	depends on ISP_SERVER_MELIS
	default n

config SUPPORT_THREE_CAMERA_MELIS
	bool "support three camera read flash in melis"
	depends on ISP_SERVER_MELIS
	default n

config ISP_SEND_TDM_RAW_TO_MELIS
	bool "use ISP send tdm raw to melis"
	depends on ISP_SERVER_MELIS
	depends on TDM_OFFLINE_HANDLE_RAW
	default n

config ISP_SEND_TDM_RAW_TO_FASTBOOT_MPP
	bool "use ISP send tdm raw to fastboot mpp"
	depends on ISP_SERVER_MELIS
	depends on TDM_OFFLINE_HANDLE_RAW
	default n

config VIDEO_SUNXI_VIN_SPECIAL
	bool "vin is used by other kernel drivers"
	default n

menu "sensor driver select"
source "drivers/media/platform/sunxi-vin/modules/sensor/Kconfig"
endmenu
```

## lichee/linux-4.9/drivers/media/platform/sunxi-vin/modules/sensor/Kconfig
```kconfig
config SENSOR_AR0238
	tristate "use ar0238 driver"
	default n

config SENSOR_AR0238_HISPI
	tristate "use ar0238_hispi driver"
	default n

config SENSOR_OV5640
	tristate "use ov5640 driver"
	default n

config SENSOR_OV2775_MIPI
	tristate "use ov2775_mipi driver"
	default n

config SENSOR_OV2710_MIPI
	tristate "use ov2710_mipi driver"
	default n

config SENSOR_OV2718_MIPI
	tristate "use ov2718_mipi driver"
	default n

config SENSOR_OV7251_MIPI
	tristate "use ov7251_mipi driver"
	default n

config SENSOR_OV2735_MIPI
	tristate "use ov2735_mipi driver"
	default n

config SENSOR_OV7750_MIPI
	tristate "use ov7750_mipi driver"
	default n

config SENSOR_OV02B10_MIPI
	tristate "use ov02b10_mipi driver"
	default n

config SENSOR_OV8856_MIPI
	tristate "use ov8856_mipi driver"
	default n

config SENSOR_OV5648
	tristate "use ov5658 driver"
	default n

config SENSOR_OS02G10
	tristate "use os02g10 driver"
	default n

config SENSOR_GC2145
	tristate "use gc2145 driver"
	default n

config SENSOR_GC1054_MIPI
	tristate "use gc1054_mipi driver"
	default n

config SENSOR_GC1084_MIPI
	tristate "use gc1084_mipi driver"
	default n

config SENSOR_GC1084_8BIT_MIPI
	bool "use gc1084_mipi 8bit"
	depends on SENSOR_GC1084_MIPI
	default n

config SENSOR_GC0308_MIPI
	tristate "use gc0308_mipi driver"
	default n

config SENSOR_GC0310_MIPI
	tristate "use gc0310_mipi driver"
	default n

config SENSOR_GC2355_MIPI
	tristate "use gc2355_mipi driver"
	default n

config SENSOR_GC2053_MIPI
	tristate "use gc2053_mipi driver"
	default n

config SENSOR_GC2053_8BIT_MIPI
	bool "use gc2053_mipi 8bit"
	depends on SENSOR_GC2053_MIPI
	default n

config SENSOR_GC2083_MIPI
	tristate "use gc2083_mipi driver"
	default n

config SENSOR_GC2093_MIPI
	tristate "use gc2093_mipi driver"
	default n

config SENSOR_GC4023_MIPI
	tristate "use gc4023_mipi driver"
	default n

config SENSOR_GC4663_MIPI
	tristate "use gc4663_mipi driver"
	default n

config SENSOR_GC0403_MIPI
	tristate "use gc0403_mipi driver"
	default n

config SENSOR_GC5025_MIPI
	tristate "use gc5025_mipi driver"
	default n

config SENSOR_GC5035_MIPI
	tristate "use gc5035_mipi driver"
	default n

config SENSOR_GC5603_MIPI
	tristate "use gc5603_mipi driver"
	default n

config SENSOR_GC02M1_MIPI
	tristate "use gc02m1_mipi driver"
	default n

config SENSOR_SC1346_MIPI
	tristate "use sc1346_mipi driver"
	default n

config SENSOR_VS4388_MIPI
	tristate "use vs4388_mipi driver"
	default n

config SENSOR_VS4388_8BIT_MIPI
	bool "use vs4388_mipi 8bit"
	depends on SENSOR_VS4388_MIPI
	default n

config SENSOR_SC2232_MIPI
	tristate "use sc2232_mipi driver"
	default n

config SENSOR_SC2336_MIPI
	tristate "use sc2336_mipi driver"
	default n

config SENSOR_SC5336_MIPI
	tristate "use sc5336_mipi driver"
	default n

config SENSOR_SC5336P_MIPI
	tristate "use sc5336p_mipi driver"
	default n

config SENSOR_SC2355_MIPI
	tristate "use sc2355_mipi driver"
	default n

config SENSOR_SC031GS_MIPI
	tristate "use sc031gs_mipi driver"
	default n

config SENSOR_SC500AI_MIPI
	tristate "use sc500ai_mipi driver"
	default n

config SENSOR_SC530AI_MIPI
	tristate "use sc530ai_mipi driver"
	default n

config SENSOR_SC200AI_MIPI
	tristate "use sc200ai_mipi driver"
	default n

config SENSOR_SC200AI_8BIT_MIPI
	bool "use sc200ai_mipi 8bit"
	depends on SENSOR_SC200AI_MIPI
	default n

config SENSOR_SC3335_MIPI
	tristate "use sc3335_mipi driver"
	default n

config SENSOR_SC3336_MIPI
	tristate "use sc3336_mipi driver"
	default n

config SENSOR_SC3338_MIPI
	tristate "use sc3338_mipi driver"
	default n

config SENSOR_SC4336_MIPI
	tristate "use sc4336_mipi driver"
	default n

config SENSOR_SC4336P_MIPI
	tristate "use sc4336p_mipi driver"
	default n

config SENSOR_SP2306_MIPI
	tristate "use sp2306_mipi driver"
	default n

config SENSOR_IMX214
	tristate "use imx214 driver"
	default n

config SENSOR_IMX219
	tristate "use imx219 driver"
	default n

config SENSOR_IMX274_SLVDS
	tristate "use imx274_slvds driver"
	default n

config SENSOR_IMX291_DVP
	tristate "use imx291_dvp driver"
	default n

config SENSOR_IMX291_MIPI
	tristate "use imx291_mipi driver"
	default n

config SENSOR_IMX317_MIPI
	tristate "use imx317_mipi driver"
	default n

config SENSOR_IMX335_MIPI
	tristate "use imx335_mipi driver"
	default n

config SENSOR_IMX326_MIPI
	tristate "use imx326_mipi driver"
	default n

config SENSOR_IMX477_MIPI
	tristate "use imx477_mipi driver"
	default n

config SENSOR_IMX278_MIPI
	tristate "use imx278_mipi driver"
	default n

config SENSOR_IMX258_MIPI
	tristate "use imx258_mipi driver"
	default n

config SENSOR_IMX386_MIPI
	tristate "use imx386_mipi driver"
	default n

config SENSOR_IMX386_2LANE_MIPI
	tristate "use imx386_2lane_mipi driver"
	default n

config SENSOR_IMX230_MIPI
	tristate "use imx230_mipi driver"
	default n

config SENSOR_S5K3H5XA
	tristate "use s5k3h5xa driver"
	default n

config SENSOR_TP9950
	tristate "use tp9950 driver"
	default n

config SENSOR_TP9953
	tristate "use tp9953 driver"
	default n

config SENSOR_TP9963
	tristate "use tp9963 driver"
	default n

config SENSOR_OFILM0092
	tristate "use ofilm0092 driver"
	default n

config SENSOR_OS03B10
	tristate "use os03B10 driver"
	default n

config SENSOR_F37P
	tristate "use f37p driver"
	default n

config SENSOR_F37P_VC
	tristate "use f37p_vc driver"
	default n

config SENSOR_OS04A10
	tristate "use os04a10 driver"
	default n

config SENSOR_K302P
	tristate "use k302p driver"
	default n

config SENSOR_K06
	tristate "use k06 driver"
	default n

config SENSOR_F53
	tristate "use f53 driver"
	default n

config SENSOR_MIS2008_MIPI
	tristate "use mis2008_mipi driver"
	default n

config SENSOR_H63_MIPI
	tristate "use h63_mipi driver"
	default n

config SENSOR_H63_DVP
	tristate "use h63_dvp driver"
	default n

config SENSOR_F355P_MIPI
	tristate "use f355p_mipi driver"
	default n

config SENSOR_F355P_DVP
	tristate "use f355p_dvp driver"
	default n

config SENSOR_BF2253L_MIPI
	tristate "use bf2253l_mipi driver"
	default n

config SENSOR_GC0406_MIPI
	tristate "use gc0406_mipi driver"
	default n

config SENSOR_SC2336P_MIPI
	tristate "use sc2336p_mipi driver"
	default n

config SENSOR_BF2257CS_MIPI
	tristate "use bf2257cs_mipi driver"
	default n

config SENSOR_SC202CS_MIPI
	tristate "use sc202cs_mipi driver"
	default n

config SENSOR_SC202CS_VC_MIPI
	tristate "use sc202cs_vc_mipi driver"
	default n

config SENSOR_CV5003_MIPI
	tristate "use cv5003_mipi driver"
	default n

config SENSOR_PTN
	tristate "use ptn driver"
	default n
```

## lichee/melis-v3.0/amp-spl/arch/Kconfig
```kconfig
config ARCH_RISCV32
	bool

config ARCH_RISCV64
	bool

config ARCH_RISCV
	bool

config SUNXI_NCAT_V2
	bool

config ARCH_CPU_E907
	select ARCH_RISCV32
	select ARCH_RISCV
	bool

config CHIP_PLATFORM
	string
	default "SUN8IW21P1" if SUN8IW21P1

config ARCH_PLATFORM
	string
	default "riscv" if ARCH_RISCV32
	default "riscv" if ARCH_RISCV32

config BITS_PER_LONG
	int "bits per long"
	default 32 if ARCH_RISCV32
	default 64 if ARCH_RISCV64

choice PLATFORM
	prompt "Sunxi-chip to use"
	help
	the ic we use for build

config SUN8IW21P1
	bool
	select ARCH_CPU_E907
	select SUNXI_NCAT_V2
	prompt "AW1886 platform"
endchoice

menu "toolchain config"
config TOOLCHAIN_PACKAGE
	string "toolchain package"
	default "tools/riscv64-elf-x86_64-20201104.tar.gz" if ARCH_CPU_E907

config TOOLCHAIN_PATH
	string "toolchain path"
	default "tools/riscv64-elf-x86_64-20201104" if ARCH_CPU_E907

config TOOLCHAIN_PREFIX
	string "toolchain prifix"
	default "riscv64-unknown-elf-" if ARCH_CPU_E907

config TOOLCHAIN_MACH_FLAGS
	string "toolchain mach flags"
	default "-mcmodel=medany -mabi=ilp32d -march=rv32imafdcxthead" if ARCH_CPU_E907

config TOOLCHAIN_LD_FLAGS
	string "toolchain ldflags"
	default "-nostartfiles -nodefaultlibs --gc-sections" if ARCH_CPU_E907

config ELF_FORMAT
	string
	default "-melf32lriscv" if ARCH_RISCV32
	default "-melf64lriscv" if ARCH_RISCV64

endmenu
```

## lichee/melis-v3.0/amp-spl/driver/vin/Kconfig
```kconfig
menuconfig VIN_USED
	bool "vin used"
	depends on TWI_USED

if VIN_USED
config SENSOR_OV7251_MIPI
	bool "ov7251 driver"
	default n

config SENSOR_GC2053_MIPI
	bool "gc2053 driver"
	default n

config SENSOR_GC4663_MIPI
	bool "gc4663 driver"
	default n
endif
```

## lichee/melis-v3.0/source/ekernel/arch/Kconfig
```kconfig
menu "ARCH Support"

config  RISCV
	bool "Support riscv ISA processors"
	default y

if RISCV
source "ekernel/arch/riscv/Kconfig"
endif

config PANIC_CLI
	bool "Enter CLI When Crash"
	default y

if PANIC_CLI
config PANIC_CLI_PWD
	bool "Panic CLI Password"
	default y

endif

endmenu
```

## lichee/melis-v3.0/source/ekernel/arch/riscv/Kconfig
```kconfig
menu "RISC-V ARCH Setup"

config SUPPORT_FP_KERNEL
	bool  "kernel compiled with/without 'fd' flag, AKA vfp support"
	default n
	depends on RISCV
	help
		kernel compiled with/without 'fd' flag, AKA vfp support"

choice
    prompt "RISCV bit mode"
	default RV32

config RV32
	bool  "CPU Support rv32bit ISA"
	depends on RISCV
	help
		processor supports rv32bit mode.
endchoice

config RV_MACHINE_MODE
	bool "Kernel Run In Machine Mode"
	depends on RISCV
	default n

config RV_CLINT
	bool "Kernel CLINT Driver"
	depends on RISCV
	default n

config CPU_DCACHE_DISABLE
    bool  "Disable RISCV CPU Dcache"
	default n
	depends on RISCV
	help
		Disable RISCV CPU Dcache.

config ARCH_RISCV_FPU
    bool  "CPU Support FPU"
	default n
	depends on RISCV
	help
		CPU Spuuort RISCV FPU.

choice
	prompt "Selete Float Point Format"
	default FPU_DOUBLE
config FPU_FLOAT
	bool "Use Singal float"
	depends on ARCH_RISCV_FPU
config FPU_DOUBLE
	bool "Use Double float"
	depends on ARCH_RISCV_FPU
endchoice

menuconfig ARCH_RISCV_INTERRUPT_NEST
	bool "interrupt nest support"
	depends on ARCH_SUN20IW3
	default n

if ARCH_RISCV_INTERRUPT_NEST
config SET_CLICINTCTL_NLBITS
	int "CLICINTCTL.nlbits"
	depends on ARCH_SUN20IW3
	default 2
	help
	  Determine the valid bit for interrupt level.
	  The value should not be larger than the platform fixed CLICINTCTLBITS.

config INTERRUPT_NEST_STACK
	int "interrupt nest stack(byte)"
	default 4096
	help
	  Larger than Number of interrupt nest * Context size.

menuconfig INTERRUPT_NEST_DEBUG
	bool "interrupt nest debug"
	default n

if INTERRUPT_NEST_DEBUG
config INTERRUPT_NEST_DEBUG_LOG
	bool "nest debug log"
	default n
	help
	  Enable CLIC debug log for intterrupt nest.

endif
endif

source "ekernel/arch/riscv/sunxi/Kconfig"

endmenu
```

## lichee/rtos-hal/hal/source/awnn/Kconfig
```kconfig
menu "AWNN LIBRARY"

config LIB_AWNN
    bool "enable awnn lib"
        default n

config HAL_TEST_AWNN
    bool "enable awnn test command"
    depends on LIB_AWNN
        default n
endmenu
```

## lichee/rtos-hal/hal/source/npu/Kconfig
```kconfig
menu "NPU Devices"

config DRIVERS_NPU
    bool "enable npu driver"
        default n

config NPU_RPMSG
    bool "enable npu rpmsg init for linux"
    depends on DRIVERS_NPU
        default n

config HAL_TEST_NPU
    bool "enable npu vpm_run demo test command"
    depends on DRIVERS_NPU
        default n
endmenu
```
